## conf/layer.conf
```bitbake
# We have a conf and classes directory, append to BBPATH
BBPATH .= ":${LAYERDIR}"

# We have a recipes directory, add to BBFILES
BBFILES += "${LAYERDIR}/recipes*/*/*.bb ${LAYERDIR}/recipes*/*/*.bbappend"

BBFILE_COLLECTIONS += "meta-embedded-bagels"
BBFILE_PATTERN_meta-embedded-bagels := "^${LAYERDIR}/"
BBFILE_PRIORITY_meta-embedded-bagels = "90"

PREFERRED_PROVIDER_ffmpeg ?= "ffmpeg"

LICENSE_FLAGS_WHITELIST ?= "commercial"
COMMERCIAL_LICENSE ?= "ffmpeg"
```
